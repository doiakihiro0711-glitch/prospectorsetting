## config/west.yml
```yaml
manifest:
  remotes:
    - name: zmkfirmware
      url-base: https://github.com/zmkfirmware
    - name: carrefinho
      url-base: https://github.com/carrefinho
    - name: bwshockley          # ← 追加
      url-base: https://github.com/bwshockley
  projects:
    - name: zmk
      remote: zmkfirmware
      revision: v0.3
      import: app/west.yml
    - name: prospector-zmk-module
      remote: carrefinho
      revision: main
      remote: bwshockley
      revision: main
  self:
    path: config
```
